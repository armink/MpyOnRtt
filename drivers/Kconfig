## drivers/Kconfig
```kconfig
config BOARD_ART_6LOWPAN
    bool 
    select ARCH_ARM_CORTEX_M4
    default y

config RT_USING_UART1
    bool "Enable UART1"
    default y
    
config RT_USING_UART2
    bool "Enable UART2"
    default n

config RT_USING_UART3
    bool "Enable UART3"
    default y

config RT_USING_SPI1
    bool "Enable SPI1"
    default n
```
